## main/Kconfig.projbuild
```kconfig
menu "Sony GRX7 Remote Configuration"

    config SONY_WIFI_SSID_1
        string "WiFi SSID 1 (Principal)"
        default "SEU_WIFI_PRINCIPAL"
        help
            Nome da primeira rede Wi-Fi (2.4 GHz) para o ESP32 conectar.

    config SONY_WIFI_PASSWORD_1
        string "WiFi Password 1"
        default "SUA_SENHA_1"
        help
            Senha da primeira rede Wi-Fi.

    config SONY_WIFI_SSID_2
        string "WiFi SSID 2 (Secundario / Fallback)"
        default "SEU_WIFI_SECUNDARIO"
        help
            Nome da segunda rede Wi-Fi (2.4 GHz) caso a primeira falhe.

    config SONY_WIFI_PASSWORD_2
        string "WiFi Password 2"
        default "SUA_SENHA_2"
        help
            Senha da segunda rede Wi-Fi.

    config SONY_IR_GPIO
        int "IR Transmitter GPIO Pin"
        range 0 39
        default 13
        help
            Pino GPIO onde o LED IR (TIL32) ou transistor driver esta conectado.

endmenu
```

## sdkconfig.defaults
```kconfig
CONFIG_HTTPD_MAX_REQ_HDR_LEN=1024
CONFIG_HTTPD_MAX_URI_LEN=512
CONFIG_HTTPD_WS_SUPPORT=y
CONFIG_APP_BUILD_MINIMIZE_BINARY_CHANGES=y
CONFIG_APP_COMPILE_TIME_DATE=n
CONFIG_BOOTLOADER_COMPILE_TIME_DATE=n
CONFIG_BOOTLOADER_LOG_LEVEL_WARN=y
CONFIG_BOOTLOADER_APP_ROLLBACK_ENABLE=y
CONFIG_ESPTOOLPY_FLASHMODE_QIO=y
CONFIG_ESPTOOLPY_FLASHFREQ_80M=y
CONFIG_ESPTOOLPY_FLASHSIZE_4MB=y
CONFIG_PARTITION_TABLE_CUSTOM=y
CONFIG_PARTITION_TABLE_CUSTOM_FILENAME="partitions.csv"
CONFIG_ESP_DEFAULT_CPU_FREQ_MHZ_80=y
```
